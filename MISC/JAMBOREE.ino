/*
    Generated by digiduck at Sun Jul 21 17:29:01 2024
      GUI r
    DELAY 500
    STRING https://JAMBOREE.rmccurdy.com
    ENTER

*/

#include <DigiKeyboard.h>
/* Constants, filled by digiduck */
const uint32_t PAYLOAD_LEN = 66;
const PROGMEM uint8_t PAYLOAD[PAYLOAD_LEN] = { 0x15, 0x8, 0x0, 0xff, 0x0, 0xf5, 0xb, 0x0, 0x17, 0x0, 0x17, 0x0, 0x13,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 0x28, 0x0 };
const uint32_t LOOPS = 2; //Count of code-executions
const uint32_t LOOP_DELAY = 1000; //Delay between code-executions
const uint32_t INITIAL_DELAY = 50; //Initial delay for device-initialization
const bool BLINK = true; //Blink when finished?
const uint32_t BLINK_DELAY = 500; //Delay between blinks

/* Runtime variables */
uint32_t loops = LOOPS;
union Instruction_t {
    uint16_t raw;
    struct KeyData_t {
        uint8_t key;
        uint8_t mod;  
    } keyData;
} instruction;

/* Initial setup */
void setup() {
    if (BLINK) {
        pinMode(0, OUTPUT); //LED on Model B
        pinMode(1, OUTPUT); //LED on Model A
    }
    DigiKeyboard.delay(INITIAL_DELAY);
}

void loop() {
    if (loops > 0) {
        /* Execute payload */
        for (uint32_t i = 0; i < PAYLOAD_LEN; i += 2) {
            instruction.raw = pgm_read_word_near(PAYLOAD + i);
            if (instruction.keyData.key == 0)
                DigiKeyboard.delay(instruction.keyData.mod);
            else
                DigiKeyboard.sendKeyStroke(instruction.keyData.key, instruction.keyData.mod);
        }
        loops--;
        DigiKeyboard.delay(LOOP_DELAY);
    } else if (BLINK) {
        digitalWrite(0, HIGH);
        digitalWrite(1, HIGH);
        delay(BLINK_DELAY / 2);
        digitalWrite(0, LOW);
        digitalWrite(1, LOW);
        delay(BLINK_DELAY / 2);
    }
}
